## m5stack/matter/light/sdkconfig.defaults
```kconfig
# Configuration for M5Stack Core S3 Matter Light Demo

# ESP32-S3 target configuration
CONFIG_IDF_TARGET="esp32s3"

# Thread configuration for M5Stack H2 Gateway
CONFIG_ENABLE_CHIP_SHELL=y
CONFIG_ENABLE_THREAD=y
CONFIG_ENABLE_THREAD_COMMISSIONING=y
CONFIG_THREAD_BORDER_ROUTER=n
CONFIG_THREAD_RADIO_TYPE_UART=y

# Bluetooth configuration for commissioning
CONFIG_BT_ENABLED=y
CONFIG_BT_NIMBLE_ENABLED=y
CONFIG_BT_NIMBLE_MAX_CONNECTIONS=4

# Display configuration 
CONFIG_LCD_ENABLE_RGB_PANEL=y
CONFIG_LCD_RGB_PIXEL_FORMAT_RGB565=y

# Memory optimization for Matter
CONFIG_SPIRAM=y
CONFIG_SPIRAM_MODE_OCT=y
CONFIG_SPIRAM_SPEED_80M=y

# Matter specific configurations
CONFIG_ENABLE_MATTER=y
CONFIG_MATTER_DEVICE_TYPE_LIGHT=y
CONFIG_MATTER_THREAD_CHANNEL=15

# Logging configuration
CONFIG_LOG_DEFAULT_LEVEL_INFO=y
CONFIG_LOG_MAXIMUM_LEVEL_DEBUG=y

# Network configuration
CONFIG_LWIP_IPV6=y
CONFIG_LWIP_IPV6_AUTOCONFIG=y
```
